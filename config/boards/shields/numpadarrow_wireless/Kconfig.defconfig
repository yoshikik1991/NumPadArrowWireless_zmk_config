## config/boards/shields/numpadarrow_wireless/Kconfig.defconfig
```kconfig
# Copyright (c) 2020 Pete Johanson, Richard Jones
# SPDX-License-Identifier: MIT

if SHIELD_NumPadArrowWireless

config ZMK_KEYBOARD_NAME
    default "NumPadArrow"

config ZMK_KSCAN_MATRIX_POLLING
    default y

if ZMK_DISPLAY

choice SSD1306_CONTROLLER_TYPE
	default SSD1306_SH1106_COMPATIBLE if SHIELD_SH1106_128X64
endchoice

if LVGL

config LV_Z_VDB_SIZE
	default 64

config LV_Z_DPI
	default 116 if SHIELD_SH1106_128X64
	default 148

config LV_Z_BITS_PER_PIXEL
	default 1

choice LV_COLOR_DEPTH
	default LV_COLOR_DEPTH_1
endchoice

config LV_DISP_SW_ROTATE
    default y

choice LV_DISP_ROT
	default LV_DISP_ROT_180
endchoice


endif # LVGL

endif # DISPLAY
    
endif
```

## config/shields/numpadarrow_wireless/Kconfig.shield
```kconfig
# Copyright (c) 2020 Pete Johanson, Richard Jones
# SPDX-License-Identifier: MIT

config SHIELD_NumPadArrowWireless
    def_bool $(shields_list_contains,numpadarrow_wireless)
```
